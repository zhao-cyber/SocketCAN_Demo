VERSION ""

NS_ :

BS_:

BU_: ECU1 ECU2

BO_ 1 Message1: 8 ECU1
 SG_ Signal1 : 0|8@1+ (1,0) [0|255] "km/h" ECU2
 SG_ Signal2 : 8|8@1+ (0.5,0) [0|100] "%" ECU2

BO_ 2 Message2: 8 ECU2
 SG_ Signal3 : 0|16@1- (0.01,0) [0|655.35] "V" ECU1
 SG_ Signal4 : 16|16@1- (0.01,0) [0|655.35] "A" ECU1

CM_ BO_ 1 "This is a message with two signals";
CM_ BO_ 2 "This is another message with two signals";
CM_ SG_ 1 Signal1 "This is a signal for speed";
CM_ SG_ 1 Signal2 "This is a signal for throttle";
CM_ SG_ 2 Signal3 "This is a signal for voltage";
CM_ SG_ 2 Signal4 "This is a signal for current";
